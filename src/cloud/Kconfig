## src/cloud/Kconfig
```kconfig
#
# Copyright (c) 2021 Nordic Semiconductor
#
# SPDX-License-Identifier: LicenseRef-BSD-5-Clause-Nordic
#

module = CLOUD_INTEGRATION
module-str = Cloud integration layer
source "subsys/logging/Kconfig.template.log_config"
```

## src/cloud/cloud_codec/Kconfig
```kconfig
#
# Copyright (c) 2021 Nordic Semiconductor
#
# SPDX-License-Identifier: LicenseRef-BSD-5-Clause-Nordic
#

module = CLOUD_CODEC
module-str = Cloud codec
source "subsys/logging/Kconfig.template.log_config"
```

## src/modules/Kconfig.modules_common
```kconfig
#
# Copyright (c) 2021 Nordic Semiconductor
#
# SPDX-License-Identifier: LicenseRef-BSD-5-Clause-Nordic
#

module = MODULES_COMMON
module-str = Common modules
source "subsys/logging/Kconfig.template.log_config"
```

## src/modules/Kconfig.sensor_module
```kconfig
#
# Copyright (c) 2021 Nordic Semiconductor
#
# SPDX-License-Identifier: LicenseRef-BSD-5-Clause-Nordic
#

menuconfig SENSOR_MODULE
	bool "Sensor module"
	select EXTERNAL_SENSORS if BOARD_THINGY91_NRF9160NS
	default y

if SENSOR_MODULE

config SENSOR_THREAD_STACK_SIZE
	int "Sensor module thread stack size"
	default 1024

rsource "../ext_sensors/Kconfig"

endif # SENSOR_MODULE

module = SENSOR_MODULE
module-str = Sensor module
source "subsys/logging/Kconfig.template.log_config"
```
