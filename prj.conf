## CMakeLists.txt
```
#
# Copyright (c) 2021 Nordic Semiconductor ASA
#
# SPDX-License-Identifier: LicenseRef-Nordic-5-Clause
#

cmake_minimum_required(VERSION 3.13.1)

find_package(Zephyr REQUIRED HINTS $ENV{ZEPHYR_BASE})
project(asset_tracker_v2)

# NORDIC SDK APP START
target_sources(app PRIVATE src/main.c)
# NORDIC SDK APP END

# Include source directory
target_include_directories(app PRIVATE src)
target_include_directories(app PRIVATE boards/${BOARD}/)

# Application directories
add_subdirectory(src/modules)
add_subdirectory(src/events)

add_subdirectory_ifdef(CONFIG_CLOUD_MODULE src/cloud)
add_subdirectory_ifdef(CONFIG_SENSOR_MODULE src/ext_sensors)
add_subdirectory_ifdef(CONFIG_WATCHDOG_APPLICATION src/watchdog)

# Include Memfault sample config
add_subdirectory_ifdef(CONFIG_MEMFAULT ../ncs/samples/nrf9160/memfault/config)
```

## Kconfig
```
#
# Copyright (c) 2021 Nordic Semiconductor ASA
#
# SPDX-License-Identifier: LicenseRef-Nordic-5-Clause
#

menu "Asset Tracker"

config ASSET_TRACKER_V2_APP_VERSION
	string "Asset Tracker application firmware version"
	default AZURE_FOTA_APP_VERSION if AZURE_IOT_HUB && AZURE_FOTA && !AZURE_FOTA_APP_VERSION_AUTO
	default "0.0.0-development"

config ASSET_TRACKER_V2_APP_VERSION_MAX_LEN
	int "Maximum length of application firmware version"
	default 150

rsource "src/modules/Kconfig.modules_common"
rsource "src/modules/Kconfig.app_module"
rsource "src/modules/Kconfig.cloud_module"
rsource "src/modules/Kconfig.data_module"
rsource "src/modules/Kconfig.gps_module"
rsource "src/modules/Kconfig.modem_module"
rsource "src/modules/Kconfig.sensor_module"
rsource "src/modules/Kconfig.ui_module"
rsource "src/modules/Kconfig.util_module"

rsource "src/cloud/cloud_codec/Kconfig"
rsource "src/watchdog/Kconfig"
rsource "src/events/Kconfig"

endmenu

menu "Zephyr Kernel"
source "Kconfig.zephyr"
endmenu

module = APPLICATION_MODULE
module-str = Application module
source "subsys/logging/Kconfig.template.log_config"
```

## sample.yaml
```
sample:
  name: Asset Tracker v2 Application
tests:
  applications.asset_tracker_v2:
    build_only: true
    build_on_all: true
    platform_allow: nrf9160dk_nrf9160ns thingy91_nrf9160ns
    extra_configs:
      - CONFIG_AWS_IOT_BROKER_HOST_NAME="example-hostname.aws.com"
      - CONFIG_AZURE_IOT_HUB_DPS_HOSTNAME="example.azure-devices-provisioning.net"
      - CONFIG_AZURE_IOT_HUB_DPS_ID_SCOPE="IDSCOPE"
    tags: ci_build
```

## west.yml
```
manifest:
  version: "0.10"
  remotes:
    - name: nordic
      url-base: https://github.com/nrfconnect
  projects:
    - name: sdk-nrf
      path: nrf
      remote: nordic
      revision: v2.5-branch
      import: true
  self:
    path: firmware
```

## prj.conf
```kconfig
#
# Copyright (c) 2021 Nordic Semiconductor ASA
#
# SPDX-License-Identifier: LicenseRef-Nordic-5-Clause
#

# General config
CONFIG_NEWLIB_LIBC=y
CONFIG_NEWLIB_LIBC_FLOAT_PRINTF=y
CONFIG_ASSERT=y
CONFIG_REBOOT=y
CONFIG_RESET_ON_FATAL_ERROR=n

# Heap and stacks
CONFIG_HEAP_MEM_POOL_SIZE=32768
CONFIG_MAIN_STACK_SIZE=1280
CONFIG_SYSTEM_WORKQUEUE_STACK_SIZE=2048
CONFIG_HW_STACK_PROTECTION=y

# Logging
CONFIG_LOG=y
CONFIG_LOG_MODE_IMMEDIATE=y

# DK - Used for buttons and LEDs in UI module.
CONFIG_DK_LIBRARY_INVERT_LEDS=n

# nRF modem library
CONFIG_NRF_MODEM_LIB=y

# Network
CONFIG_NETWORKING=y
CONFIG_NET_NATIVE=n
CONFIG_NET_SOCKETS=y
CONFIG_NET_SOCKETS_OFFLOAD=y

# LTE link control
CONFIG_LTE_AUTO_INIT_AND_CONNECT=n
CONFIG_LTE_NETWORK_MODE_LTE_M_GPS=y
## Power saving timers.
CONFIG_LTE_PSM_REQ_RPTAU="01000011"
CONFIG_LTE_PSM_REQ_RAT="00000000"

# Cloud backend - To use a specific cloud backend uncomment the corresponding
#                 section.

# AWS IoT
## Mandatory application specific configurations for AWS_IOT.
CONFIG_AWS_IOT=y
CONFIG_AWS_IOT_TOPIC_UPDATE_DELTA_SUBSCRIBE=y
CONFIG_AWS_IOT_TOPIC_GET_REJECTED_SUBSCRIBE=y
CONFIG_AWS_IOT_AUTO_DEVICE_SHADOW_REQUEST=y
CONFIG_AWS_IOT_MQTT_RX_TX_BUFFER_LEN=2048
CONFIG_AWS_IOT_MQTT_PAYLOAD_BUFFER_LEN=2048
CONFIG_AWS_IOT_APP_SUBSCRIPTION_LIST_COUNT=1
CONFIG_AWS_IOT_CLIENT_ID_APP=y
CONFIG_AWS_FOTA=y

## AWS IoT options that must be configured.
CONFIG_AWS_IOT_SEC_TAG=42
CONFIG_AWS_IOT_BROKER_HOST_NAME=""

# ## Azure IoT Hub
# # Mandatory application specific configurations for AZURE_IOT_HUB.
# CONFIG_AZURE_IOT_HUB=y
# CONFIG_AZURE_IOT_HUB_DPS=y
# CONFIG_AZURE_IOT_HUB_AUTO_DEVICE_TWIN_REQUEST=y
# CONFIG_AZURE_IOT_HUB_DEVICE_ID_APP=y
# CONFIG_AZURE_IOT_HUB_MQTT_PAYLOAD_BUFFER_LEN=2048
# CONFIG_AZURE_IOT_HUB_MQTT_RX_TX_BUFFER_LEN=2048
# CONFIG_AZURE_IOT_HUB_TOPIC_PROPERTY_BAG_PREFIX=n
# CONFIG_AZURE_IOT_HUB_STACK_SIZE=4096
# CONFIG_AZURE_FOTA=y
# CONFIG_AZURE_FOTA_TLS=y

# # Azure IoT Hub options that must be configured.
# CONFIG_AZURE_IOT_HUB_DPS_ID_SCOPE=""
# CONFIG_AZURE_IOT_HUB_DPS_HOSTNAME=""
# CONFIG_AZURE_IOT_HUB_SEC_TAG=11
# CONFIG_AZURE_FOTA_SEC_TAG=11

# MQTT
# Keepalive should be set to the maximum specified MQTT keepalive timeout of the
#        selected cloud library.
#        1200 seconds for AWS IoT.
#        1767 seconds for Azure IoT Hub.
CONFIG_MQTT_KEEPALIVE=1200

# Settings - Used to store real-time device configuration to flash.
CONFIG_SETTINGS=y
CONFIG_SETTINGS_FCB=y
CONFIG_FCB=y

# FOTA - Needed by AWS_FOTA and AZURE_FOTA.
CONFIG_FOTA_DOWNLOAD=y
CONFIG_DFU_TARGET=y
CONFIG_DOWNLOAD_CLIENT=y
CONFIG_DOWNLOAD_CLIENT_HTTP_FRAG_SIZE_1024=y
CONFIG_DOWNLOAD_CLIENT_STACK_SIZE=4096
CONFIG_DOWNLOAD_CLIENT_BUF_SIZE=2300
CONFIG_DOWNLOAD_CLIENT_MAX_HOSTNAME_SIZE=128

# Flash - Used in FOTA and Settings.
CONFIG_FLASH=y
CONFIG_FLASH_PAGE_LAYOUT=y
CONFIG_FLASH_MAP=y
CONFIG_MPU_ALLOW_FLASH_WRITE=y

# MCUBOOT
CONFIG_BOOTLOADER_MCUBOOT=y
CONFIG_IMG_MANAGER=y
CONFIG_MCUBOOT_IMG_MANAGER=y
CONFIG_IMG_ERASE_PROGRESSIVELY=y

# Watchdog
CONFIG_WATCHDOG_APPLICATION=y

# AGPS
# To use AGPS, a source of assistance data must be selected. By default, SUPL
# is selected. However, due to licensing, the SUPL library must be manually
# downloaded and configured according to the instructions found in the SUPL
# client library documentation in NCS.
# CONFIG_AGPS=y
# CONFIG_AGPS_SRC_SUPL=y

# Event Manager
CONFIG_EVENT_MANAGER=y
CONFIG_LINKER_ORPHAN_SECTION_PLACE=y
CONFIG_DESKTOP_EVENT_MANAGER_LOG_EVENT_TYPE=n

# cJSON - Used in AWS FOTA and cloud data traffic encoding.
CONFIG_CJSON_LIB=y
```

## asset-tracker-cloud-firmware-aws.conf
```kconfig
# Project-specific tweaks for
# https://github.com/NordicSemiconductor/asset-tracker-cloud-firmware-aws

## Enable long download URLS for FOTA
CONFIG_DOWNLOAD_CLIENT_MAX_HOSTNAME_SIZE=255
CONFIG_DOWNLOAD_CLIENT_MAX_FILENAME_SIZE=255

## Enable LTE-m, NB-IoT, and GPS
CONFIG_LTE_NETWORK_MODE_LTE_M_NBIOT_GPS=y

## Enable impact detection
## Currently the sensitivity cannot be configured, because CONFIG_ADXL372_ACTIVITY_THRESHOLD is not used.
## The low (10-15g) threshold is used.
CONFIG_EXTERNAL_SENSORS_IMPACT_DETECTION=y
```

## asset-tracker-cloud-firmware.conf
```kconfig
# Project-specific tweaks for
# https://github.com/NordicSemiconductor/asset-tracker-cloud-firmware

## Enable long download URLS for FOTA
CONFIG_DOWNLOAD_CLIENT_MAX_HOSTNAME_SIZE=255
CONFIG_DOWNLOAD_CLIENT_MAX_FILENAME_SIZE=255
```

## e2e.conf
```kconfig
CONFIG_DATA_LOCATION_TIMEOUT_SECONDS=60
```

## overlay-debug.conf
```kconfig
#
# Copyright (c) 2021 Nordic Semiconductor ASA
#
# SPDX-License-Identifier: LicenseRef-Nordic-5-Clause
#

# Forces a maximal log level for all modules.
# Modules saturates their specified level if it is greater than this option,
# otherwise they use the level specified by this option instead of their default
# or whatever was manually set. Levels are:
#
# 0 OFF, logging is turned off
# 1 ERROR, maximal level set to LOG_LEVEL_ERR
# 2 WARNING, maximal level set to LOG_LEVEL_WRN
# 3 INFO, maximal level set to LOG_LEVEL_INFO
# 4 DEBUG, maximal level set to LOG_LEVEL_DBG
CONFIG_LOG_MAX_LEVEL=4

# Module debug configurations.
CONFIG_APPLICATION_MODULE_LOG_LEVEL_DBG=y
CONFIG_CLOUD_MODULE_LOG_LEVEL_DBG=y
CONFIG_DATA_MODULE_LOG_LEVEL_DBG=y
CONFIG_GNSS_MODULE_LOG_LEVEL_DBG=y
CONFIG_MODEM_MODULE_LOG_LEVEL_DBG=y
CONFIG_SENSOR_MODULE_LOG_LEVEL_DBG=y
CONFIG_UI_MODULE_LOG_LEVEL_DBG=y
CONFIG_UTIL_MODULE_LOG_LEVEL_DBG=y
CONFIG_DEBUG_MODULE_LOG_LEVEL_DBG=y

# Cloud integration layer debug logging
CONFIG_CLOUD_INTEGRATION_LOG_LEVEL_DBG=y

# Application Watchdog debug logging
CONFIG_WATCHDOG_LOG_LEVEL_DBG=y

# Cloud codec debug logging
CONFIG_CLOUD_CODEC_LOG_LEVEL_DBG=y

# Date time
CONFIG_DATE_TIME_LOG_LEVEL_DBG=y

# Settings
CONFIG_SETTINGS_LOG_LEVEL_DBG=y

# Flash
CONFIG_STREAM_FLASH_LOG_LEVEL_DBG=y

# Debug module
CONFIG_DEBUG_MODULE=y

# QoS library
CONFIG_QOS_LOG_LEVEL_DBG=y

# nRF Cloud A/P-GPS
CONFIG_NRF_CLOUD_GPS_LOG_LEVEL_DBG=y
```

## overlay-low-power.conf
```kconfig
#
# Copyright (c) 2021 Nordic Semiconductor ASA
#
# SPDX-License-Identifier: LicenseRef-Nordic-5-Clause
#

# Disable serial interface.
CONFIG_SERIAL=n

# Disable LEDs
CONFIG_LED_CONTROL=n

# Disable UART console.
CONFIG_UART_CONSOLE=n

# Disable event logging.
CONFIG_DESKTOP_EVENT_MANAGER_SHOW_EVENTS=n
```

## prj_nrf9160dk_nrf9160ns.conf
```kconfig
#
# Copyright (c) 2021 Nordic Semiconductor ASA
#
# SPDX-License-Identifier: LicenseRef-Nordic-5-Clause
#

# General config
CONFIG_NEWLIB_LIBC=y
CONFIG_NEWLIB_LIBC_FLOAT_PRINTF=y
CONFIG_ASSERT=y
CONFIG_REBOOT=y
CONFIG_RESET_ON_FATAL_ERROR=n

# Heap and stacks
CONFIG_HEAP_MEM_POOL_SIZE=32768
CONFIG_MAIN_STACK_SIZE=1024
CONFIG_SYSTEM_WORKQUEUE_STACK_SIZE=2048
CONFIG_HW_STACK_PROTECTION=y

# Logging
CONFIG_LOG=y
CONFIG_LOG_IMMEDIATE=y

# DK - Used for buttons and LEDs in UI module.
CONFIG_DK_LIBRARY_INVERT_LEDS=n

# BSD library
CONFIG_BSD_LIBRARY=y

# Network
CONFIG_NETWORKING=y
CONFIG_NET_NATIVE=n
CONFIG_NET_SOCKETS=y
CONFIG_NET_SOCKETS_OFFLOAD=y

# LTE link control
CONFIG_LTE_AUTO_INIT_AND_CONNECT=n
CONFIG_LTE_NETWORK_MODE_LTE_M_GPS=y
## Power saving timers.
CONFIG_LTE_PSM_REQ_RPTAU="01000011"
CONFIG_LTE_PSM_REQ_RAT="00000000"

# AWS IoT
## Mandatory application specific configurations for AWS_IOT.
CONFIG_AWS_IOT=y
CONFIG_AWS_IOT_TOPIC_UPDATE_DELTA_SUBSCRIBE=y
CONFIG_AWS_IOT_AUTO_DEVICE_SHADOW_REQUEST=y
CONFIG_AWS_IOT_MQTT_RX_TX_BUFFER_LEN=2048
CONFIG_AWS_IOT_MQTT_PAYLOAD_BUFFER_LEN=2048
CONFIG_AWS_IOT_APP_SUBSCRIPTION_LIST_COUNT=1
CONFIG_AWS_IOT_CLIENT_ID_APP=y
CONFIG_AWS_FOTA=y

## AWS IoT options that must be configured.
CONFIG_AWS_IOT_SEC_TAG=42
CONFIG_AWS_IOT_BROKER_HOST_NAME="example-hostname.aws.com"

# MQTT
# Keepalive should be set to the maximum specified MQTT keepalive timeout of the
#        selected cloud library.
#        1200 seconds for AWS IoT.
CONFIG_MQTT_KEEPALIVE=1200

# Settings - Used to store real-time device configuration to flash.
CONFIG_SETTINGS=y
CONFIG_SETTINGS_FCB=y
CONFIG_FCB=y

# FOTA - Needed by AWS IoT.
CONFIG_FOTA_DOWNLOAD=y
CONFIG_DFU_TARGET=y
CONFIG_DOWNLOAD_CLIENT=y
CONFIG_DOWNLOAD_CLIENT_HTTP_FRAG_SIZE_1024=y
CONFIG_DOWNLOAD_CLIENT_STACK_SIZE=4096
CONFIG_DOWNLOAD_CLIENT_BUF_SIZE=2300

# Flash - Used in FOTA and Settings.
CONFIG_FLASH=y
CONFIG_FLASH_PAGE_LAYOUT=y
CONFIG_FLASH_MAP=y
CONFIG_MPU_ALLOW_FLASH_WRITE=y

# MCUBOOT
CONFIG_BOOTLOADER_MCUBOOT=y
CONFIG_IMG_MANAGER=y
CONFIG_MCUBOOT_IMG_MANAGER=y
CONFIG_IMG_ERASE_PROGRESSIVELY=y

# Watchdog
CONFIG_WATCHDOG_APPLICATION=y

# AGPS
# To use AGPS, a source of assistance data must be selected. By default, SUPL
# is selected. However, due to licensing, the SUPL library must be manually
# downloaded and configured according to the instructions found in the SUPL
# client library documentation in NCS.
# CONFIG_AGPS=y
# CONFIG_AGPS_SRC_SUPL=y

# Event Manager
CONFIG_EVENT_MANAGER=y
CONFIG_LINKER_ORPHAN_SECTION_PLACE=y
CONFIG_DESKTOP_EVENT_MANAGER_LOG_EVENT_TYPE=n

# cJSON - Used in AWS FOTA and cloud data traffic encoding.
CONFIG_CJSON_LIB=y
```

## src/main.c
```c
/*
 * Copyright (c) 2021 Nordic Semiconductor ASA
 *
 * SPDX-License-Identifier: LicenseRef-Nordic-5-Clause
 */

#include <zephyr.h>
#include <stdio.h>
#include <string.h>
#include <stdlib.h>
#include <event_manager.h>

#if defined(CONFIG_WATCHDOG_APPLICATION)
#include "watchdog.h"
#endif

/* Module name is used by the event manager macros in this file */
#define MODULE app_module

#include "modules_common.h"
#include "events/app_module_event.h"
#include "events/cloud_module_event.h"
#include "events/data_module_event.h"
#include "events/sensor_module_event.h"
#include "events/ui_module_event.h"
#include "events/util_module_event.h"
#include "events/modem_module_event.h"

#include <logging/log.h>
#include <logging/log_ctrl.h>

LOG_MODULE_REGISTER(MODULE, CONFIG_APPLICATION_MODULE_LOG_LEVEL);

/* Message structure. Events from other modules are converted to messages
 * in the event manager handler, and then queued up in the message queue
 * for processing in the main thread.
 */
struct app_msg_data {
	union {
		struct cloud_module_event cloud;
		struct ui_module_event ui;
		struct sensor_module_event sensor;
		struct data_module_event data;
		struct util_module_event util;
		struct modem_module_event modem;
		struct app_module_event app;
	} module;
};

/* Application module super states. */
static enum state_type {
	STATE_INIT,
	STATE_RUNNING
} state;

/* Application sub states. The application can be in either active or passive
 * mode.
 *
 * Active mode: Sensor data and GPS position is acquired at a configured
 *		interval and sent to cloud.
 *
 * Passive mode: Sensor data and GPS position is acquired when movement is
 *		 detected, or after the configured movement timeout occurs.
 */
static enum sub_state_type {
	SUB_STATE_ACTIVE_MODE,
	SUB_STATE_PASSIVE_MODE,
} sub_state;

/* Internal copy of the device configuration. */
static struct cloud_data_cfg app_cfg;

/* Timer callback used to signal when timeout has occurred both in active
 * and passive mode.
 */
static void data_sample_timer_handler(struct k_timer *timer);

/* Application module message queue. */
#define APP_QUEUE_ENTRY_COUNT		10
#define APP_QUEUE_BYTE_ALIGNMENT	4

K_MSGQ_DEFINE(msgq_app, sizeof(struct app_msg_data), APP_QUEUE_ENTRY_COUNT,
	      APP_QUEUE_BYTE_ALIGNMENT);

/* Data sample timer used in active mode. */
K_TIMER_DEFINE(data_sample_timer, data_sample_timer_handler, NULL);

/* Movement timer used to detect movement timeouts in passive mode. */
K_TIMER_DEFINE(movement_timeout_timer, data_sample_timer_handler, NULL);

/* Movement resolution timer decides the period after movement that consecutive
 * movements are ignored and do not cause data collection. This is used to
 * lower power consumption by limiting how often GPS search is performed and
 * data is sent on air.
 */
K_TIMER_DEFINE(movement_resolution_timer, NULL, NULL);

/* Module data structure to hold information of the application module, which
 * opens up for using convenience functions available for modules.
 */
static struct module_data self = {
	.name = "app",
	.msg_q = &msgq_app,
};

/* Convenience functions used in internal state handling. */
static char *state2str(enum state_type new_state)
{
	switch (new_state) {
	case STATE_INIT:
		return "STATE_INIT";
	case STATE_RUNNING:
		return "STATE_RUNNING";
	default:
		return "Unknown";
	}
}

static char *sub_state2str(enum sub_state_type new_state)
{
	switch (new_state) {
	case SUB_STATE_ACTIVE_MODE:
		return "SUB_STATE_ACTIVE_MODE";
	case SUB_STATE_PASSIVE_MODE:
		return "SUB_STATE_PASSIVE_MODE";
	default:
		return "Unknown";
	}
}

static void state_set(enum state_type new_state)
{
	if (new_state == state) {
		LOG_DBG("State: %s", state2str(state));
		return;
	}

	LOG_DBG("State transition %s --> %s",
		state2str(state),
		state2str(new_state));

	state = new_state;
}

static void sub_state_set(enum sub_state_type new_state)
{
	if (new_state == sub_state) {
		LOG_DBG("Sub state: %s", sub_state2str(sub_state));
		return;
	}

	LOG_DBG("Sub state transition %s --> %s",
		sub_state2str(sub_state),
		sub_state2str(new_state));

	sub_state = new_state;
}

/* Event manager handler. Puts event data into messages and adds them to the
 * application message queue.
 */
static bool event_handler(const struct event_header *eh)
{
	struct app_msg_data msg = {0};
	bool enqueue_msg = false;

	if (is_cloud_module_event(eh)) {
		struct cloud_module_event *evt = cast_cloud_module_event(eh);

		msg.module.cloud = *evt;
		enqueue_msg = true;
	}

	if (is_app_module_event(eh)) {
		struct app_module_event *evt = cast_app_module_event(eh);

		msg.module.app = *evt;
		enqueue_msg = true;
	}

	if (is_data_module_event(eh)) {
		struct data_module_event *evt = cast_data_module_event(eh);

		msg.module.data = *evt;
		enqueue_msg = true;
	}

	if (is_sensor_module_event(eh)) {
		struct sensor_module_event *evt = cast_sensor_module_event(eh);

		msg.module.sensor = *evt;
		enqueue_msg = true;
	}

	if (is_util_module_event(eh)) {
		struct util_module_event *evt = cast_util_module_event(eh);

		msg.module.util = *evt;
		enqueue_msg = true;
	}

	if (is_modem_module_event(eh)) {
		struct modem_module_event *evt = cast_modem_module_event(eh);

		msg.module.modem = *evt;
		enqueue_msg = true;
	}

	if (is_ui_module_event(eh)) {
		struct ui_module_event *evt = cast_ui_module_event(eh);

		msg.module.ui = *evt;
		enqueue_msg = true;
	}

	if (enqueue_msg) {
		int err = module_enqueue_msg(&self, &msg);

		if (err) {
			LOG_ERR("Message could not be enqueued");
			SEND_ERROR(app, APP_EVT_ERROR, err);
		}
	}

	return false;
}

static void data_sample_timer_handler(struct k_timer *timer)
{
	ARG_UNUSED(timer);
	SEND_EVENT(app, APP_EVT_DATA_GET_ALL);
}

/* Static module functions. */
static void data_get(void)
{
	static bool first = true;
	struct app_module_event *app_module_event = new_app_module_event();
	size_t count = 0;

	/* Specify which data that is to be included in the transmission. */
	app_module_event->data_list[count++] = APP_DATA_MODEM_DYNAMIC;
	app_module_event->data_list[count++] = APP_DATA_BATTERY;
	app_module_event->data_list[count++] = APP_DATA_ENVIRONMENTAL;

	/* Specify a timeout that each module has to fetch data. If data is not
	 * fetched within this timeout, the data that is available is sent.
	 */
	app_module_event->timeout = MAX(app_cfg.gps_timeout, 60);

	if (first) {
		if (IS_ENABLED(CONFIG_APP_REQUEST_GPS_ON_INITIAL_SAMPLING)) {
			app_module_event->data_list[count++] = APP_DATA_GNSS;
		} else {
			app_module_event->timeout = 10;
		}

		app_module_event->data_list[count++] = APP_DATA_MODEM_STATIC;
		first = false;
	} else {
		app_module_event->data_list[count++] = APP_DATA_GNSS;
	}

	/* Set list count to number of data types passed in app_module_event. */
	app_module_event->count = count;
	app_module_event->type = APP_EVT_DATA_GET;

	EVENT_SUBMIT(app_module_event);
}

/* Message handler for STATE_INIT. */
static void on_state_init(struct app_msg_data *msg)
{
	if (IS_EVENT(msg, data, DATA_EVT_CONFIG_INIT)) {
		/* Keep a copy of the new configuration. */
		app_cfg = msg->module.data.data.cfg;

		if (app_cfg.active_mode) {
			LOG_INF("Device mode: Active");
			LOG_INF("Start data sample timer: %d seconds interval",
				app_cfg.active_wait_timeout);
			k_timer_start(&data_sample_timer,
				      K_SECONDS(app_cfg.active_wait_timeout),
				      K_SECONDS(app_cfg.active_wait_timeout));
		} else {
			LOG_INF("Device mode: Passive");
			LOG_INF("Start movement timeout: %d seconds interval",
				app_cfg.movement_timeout);

			k_timer_start(&movement_timeout_timer,
				K_SECONDS(app_cfg.movement_timeout),
				K_SECONDS(app_cfg.movement_timeout));
		}

		state_set(STATE_RUNNING);
		sub_state_set(app_cfg.active_mode ? SUB_STATE_ACTIVE_MODE :
						    SUB_STATE_PASSIVE_MODE);
	}
}

/* Message handler for STATE_RUNNING. */
static void on_state_running(struct app_msg_data *msg)
{
	if (IS_EVENT(msg, data, DATA_EVT_DATE_TIME_OBTAINED)) {
		data_get();
	}

	if (IS_EVENT(msg, app, APP_EVT_DATA_GET_ALL)) {
		data_get();
	}
}

/* Message handler for SUB_STATE_PASSIVE_MODE. */
void on_sub_state_passive(struct app_msg_data *msg)
{
	if (IS_EVENT(msg, data, DATA_EVT_CONFIG_READY)) {
		/* Keep a copy of the new configuration. */
		app_cfg = msg->module.data.data.cfg;

		if (app_cfg.active_mode) {
			LOG_INF("Device mode: Active");
			LOG_INF("Start data sample timer: %d seconds interval",
				app_cfg.active_wait_timeout);
			k_timer_start(&data_sample_timer,
				      K_SECONDS(app_cfg.active_wait_timeout),
				      K_SECONDS(app_cfg.active_wait_timeout));
			k_timer_stop(&movement_timeout_timer);
			sub_state_set(SUB_STATE_ACTIVE_MODE);
			return;
		}

		LOG_INF("Device mode: Passive");
		LOG_INF("Start movement timeout: %d seconds interval",
			app_cfg.movement_timeout);

		k_timer_start(&movement_timeout_timer,
			      K_SECONDS(app_cfg.movement_timeout),
			      K_SECONDS(app_cfg.movement_timeout));
		k_timer_stop(&data_sample_timer);
	}

	if ((IS_EVENT(msg, sensor, SENSOR_EVT_MOVEMENT_DATA_READY)) ||
	    (IS_EVENT(msg, ui, UI_EVT_BUTTON_DATA_READY))) {

		if (IS_EVENT(msg, ui, UI_EVT_BUTTON_DATA_READY) &&
		    msg->module.ui.data.ui.button_number != 2) {
			return;
		}

		/* Trigger sample/publication cycle if there has been movement
		 * or button 2 has been pushed on the DK.
		 */

		if (k_timer_remaining_get(&movement_resolution_timer) == 0) {
			/* Do an initial data sample. */
			data_sample_timer_handler(NULL);

			LOG_INF("%d seconds until movement can trigger",
				app_cfg.movement_resolution);
			LOG_INF("a new data sample/publication");

			/* Start one shot timer. After the timer has expired,
			 * movement is the only event that triggers a new
			 * one shot timer.
			 */
			k_timer_start(&movement_resolution_timer,
				      K_SECONDS(app_cfg.movement_resolution),
				      K_SECONDS(0));
		}
	}
}

/* Message handler for SUB_STATE_ACTIVE_MODE. */
static void on_sub_state_active(struct app_msg_data *msg)
{
	if (IS_EVENT(msg, data, DATA_EVT_CONFIG_READY)) {
		/* Keep a copy of the new configuration. */
		app_cfg = msg->module.data.data.cfg;

		if (!app_cfg.active_mode) {
			LOG_INF("Device mode: Passive");
			LOG_INF("Start movement timeout: %d seconds interval",
				app_cfg.movement_timeout);
			k_timer_start(&movement_timeout_timer,
				      K_SECONDS(app_cfg.movement_timeout),
				      K_SECONDS(app_cfg.movement_timeout));
			k_timer_stop(&data_sample_timer);
			sub_state_set(SUB_STATE_PASSIVE_MODE);
			return;
		}

		LOG_INF("Device mode: Active");
		LOG_INF("Start data sample timer: %d seconds interval",
			app_cfg.active_wait_timeout);

		k_timer_start(&data_sample_timer,
			      K_SECONDS(app_cfg.active_wait_timeout),
			      K_SECONDS(app_cfg.active_wait_timeout));
		k_timer_stop(&movement_timeout_timer);
	}
}

/* Message handler for all states. */
static void on_all_events(struct app_msg_data *msg)
{
	if (IS_EVENT(msg, util, UTIL_EVT_SHUTDOWN_REQUEST)) {
		k_timer_stop(&data_sample_timer);
		k_timer_stop(&movement_timeout_timer);
		k_timer_stop(&movement_resolution_timer);

		SEND_EVENT(app, APP_EVT_SHUTDOWN_READY);
	}
}

void main(void)
{
	struct app_msg_data msg;

	self.thread_id = k_current_get();

	module_start(&self);

	if (event_manager_init()) {
		/* Without the event manager, the application will not work
		 * as intended. A reboot is required in an attempt to recover.
		 */
		LOG_ERR("Event manager could not be initialized, rebooting...");
		k_sleep(K_SECONDS(5));
		sys_reboot(SYS_REBOOT_COLD);
	} else {
		SEND_EVENT(app, APP_EVT_START);
	}

#if defined(CONFIG_WATCHDOG_APPLICATION)
	int err = watchdog_init_and_start();

	if (err) {
		LOG_DBG("watchdog_init_and_start, error: %d", err);
		SEND_ERROR(app, APP_EVT_ERROR, err);
	}
#endif

	while (true) {
		module_get_next_msg(&self, &msg);

		switch (state) {
		case STATE_INIT:
			on_state_init(&msg);
			break;
		case STATE_RUNNING:
			switch (sub_state) {
			case SUB_STATE_ACTIVE_MODE:
				on_sub_state_active(&msg);
				break;
			case SUB_STATE_PASSIVE_MODE:
				on_sub_state_passive(&msg);
				break;
			default:
				LOG_WRN("Unknown application sub state");
				break;
			}

			on_state_running(&msg);
			break;
		default:
			LOG_WRN("Unknown application state");
			break;
		}

		on_all_events(&msg);
	}
}

EVENT_LISTENER(MODULE, event_handler);
EVENT_SUBSCRIBE_EARLY(MODULE, cloud_module_event);
EVENT_SUBSCRIBE(MODULE, app_module_event);
EVENT_SUBSCRIBE(MODULE, data_module_event);
EVENT_SUBSCRIBE(MODULE, util_module_event);
EVENT_SUBSCRIBE_FINAL(MODULE, ui_module_event);
EVENT_SUBSCRIBE_FINAL(MODULE, sensor_module_event);
EVENT_SUBSCRIBE_FINAL(MODULE, modem_module_event);
```
